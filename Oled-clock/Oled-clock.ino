#include <Arduino.h>
#include <OneWire.h>
#include <Wire.h>
#include <SPI.h>
#include <Adafruit_GFX.h>
#include <Adafruit_SH1106.h>
#include "RTClib.h"
// display=======================================================
//Bibliothek initialisieren
#define OLED_RESET 4
Adafruit_SH1106 display(OLED_RESET);
/* DS18S20 Temperaturchip i/o */
OneWire  ds(10);  // on pin 9

RTC_DS3231 rtc;

#define temperature_width 32
#define temperature_height 32
const unsigned char temperature_bits[] PROGMEM = {
  0x1c, 0x00, 0x00, 0x00, 0x32, 0x00, 0x00, 0x00, 0x23, 0x00, 0x00, 0x00, 0x27, 0x00, 0x00, 0x00,
  0x21, 0x00, 0x00, 0x00, 0x27, 0x00, 0x00, 0x00, 0x23, 0x00, 0x00, 0x00, 0x23, 0x00, 0x00, 0x00,
  0x27, 0x00, 0x00, 0x00, 0x21, 0x00, 0x00, 0x00, 0x27, 0x00, 0x00, 0x00, 0x23, 0x00, 0x00, 0x00,
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  0x9e, 0xc0, 0x00, 0x00, 0x4c, 0x80, 0x00, 0x00, 0x61, 0x00, 0x00, 0x00, 0x1e, 0x00, 0x00, 0x00
 };

#define time_width 32
#define time_height 32
const unsigned char time_bits[] PROGMEM = {
  0x00, 0x0f, 0xf0, 0x00, 0x00, 0x7f, 0xfe, 0x00, 0x00, 0xff, 0xff, 0x80, 0x03, 0xff, 0xff, 0xc0,
	0x07, 0xe1, 0x87, 0xe0, 0x0f, 0xe1, 0x87, 0xf0, 0x1f, 0x20, 0x04, 0xf8, 0x1e, 0x00, 0x00, 0x7c,
	0x3c, 0x00, 0x00, 0x3c, 0x7c, 0x00, 0x00, 0x3e, 0x7e, 0x00, 0x00, 0x7e, 0x70, 0x40, 0x02, 0x0e,
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	0x03, 0xfd, 0xbf, 0xc0, 0x01, 0xff, 0xff, 0x80, 0x00, 0x7f, 0xfe, 0x00, 0x00, 0x0f, 0xf0, 0x00
};

#define date_width 32
#define date_height 34
const unsigned char date_bits[] PROGMEM = {
	0x01, 0x80, 0x00, 0xe0, 0x03, 0xc0, 0x00, 0xe0, 0x03, 0xc0, 0x01, 0xe0, 0x3b, 0xcf, 0xfc, 0xe4,
	0x7b, 0xcf, 0xfc, 0xe6, 0xfb, 0xcf, 0xfc, 0xe7, 0xfb, 0xcf, 0xfc, 0xe7, 0xf9, 0x9f, 0xfc, 0xef,
	0xfc, 0x1f, 0xfe, 0x0f, 0xff, 0xff, 0xff, 0xff, 0xf1, 0xc0, 0x00, 0xef, 0xf0, 0x00, 0x00, 0x0f,
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	0x7f, 0xff, 0xff, 0xff, 0x3f, 0xff, 0xff, 0xff
};

void setup() {
  Serial.begin(9600);
  display.begin(SH1106_SWITCHCAPVCC, 0x3C);
  display.setTextColor(WHITE);
  display.display();
  delay(2000);

  if (rtc.lostPower()) {
    Serial.println("RTC lost power, lets set the time!");
    // following line sets the RTC to the date & time this sketch was compiled
    rtc.adjust(DateTime(F(__DATE__), F(__TIME__)));
    // This line sets the RTC with an explicit date & time, for example to set
    // January 21, 2014 at 3am you would call:
    // rtc.adjust(DateTime(2014, 1, 21, 3, 0, 0));
  }
}

void time(int i) {
  display.clearDisplay();
  display.drawBitmap( 0, 16, time_bits, time_width, time_height, 1);
  display.setCursor(36,20);
  display.setTextSize(3);
  DateTime now = rtc.now();
  if(now.hour()<10) {
    display.print("0");
    display.print(now.hour(), DEC);
  }
  else {
    display.print(now.hour(), DEC);
  }
  if((i>499&&i<1001)||(i>1499&&i<2001)||(i>2499&&i<3001)||(i>3499&&i<4001)||(i>4499&&i<5001)){
    display.print(":");
  }
  else{
    display.print(" ");
  }
  if(now.minute()<10){
    display.print("0");
    display.print(now.minute(), DEC);
  }
  else{
    display.print(now.minute(), DEC);
  }
  display.display();
}

void date() {
  display.clearDisplay();
  display.drawBitmap( 0, 13, date_bits, date_width, date_height, 1);
  display.setCursor(40,20);
  display.setTextSize(3);
  DateTime now = rtc.now();
  if(now.day()<10) {
    display.print("0");
    display.print(now.day(), DEC);
  }
  else {
    display.print(now.day(), DEC);
  }
  display.fillRect(77, 38, 3, 3, WHITE);
  //display.print(".");
  display.setCursor(87, 20);
  if(now.month()<10) {
    display.print("0");
    display.print(now.month(), DEC);
  }
  else {
    display.print(now.month(), DEC);
  }
  display.fillRect(124, 38, 3, 3, WHITE);
  display.display();
}

void temperature() {
  byte i;
  byte present = 0;
  byte type_s;
  byte data[12];
  byte addr[8];
  float celsius;

  if ( !ds.search(addr)) {
    ds.reset_search();
    delay(250);
    return;
  }
  for( i = 0; i < 8; i++) {
  }

  if (OneWire::crc8(addr, 7) != addr[7]) {
      return;
  }
  switch (addr[0]) {
    case 0x10:
      //Serial.println("  Chip = DS18S20");  // or old DS1820
      type_s = 1;
      break;
    case 0x28:
      //Serial.println("  Chip = DS18B20");
      type_s = 0;
      break;
    case 0x22:
      //Serial.println("  Chip = DS1822");
      type_s = 0;
      break;
    default:
      //Serial.println("Device is not a DS18x20 family device.");
      return;
  }

  ds.reset();
  ds.select(addr);
  ds.write(0x44, 1);        // start conversion, with parasite power on at the end

  delay(1000);

  present = ds.reset();
  ds.select(addr);
  ds.write(0xBE);         // Read Scratchpad

  for ( i = 0; i < 9; i++) {           // we need 9 bytes
    data[i] = ds.read();
  }
  // Convert the data to actual temperature
  // because the result is a 16 bit signed integer, it should
  // be stored to an "int16_t" type, which is always 16 bits
  // even when compiled on a 32 bit processor.
  int16_t raw = (data[1] << 8) | data[0];
  if (type_s) {
    raw = raw << 3; // 9 bit resolution default
    if (data[7] == 0x10) {
      // "count remain" gives full 12 bit resolution
      raw = (raw & 0xFFF0) + 12 - data[6];
    }
  } else {
    byte cfg = (data[4] & 0x60);
    // at lower res, the low bits are undefined, so let's zero them
    if (cfg == 0x00) raw = raw & ~7;  // 9 bit resolution, 93.75 ms
    else if (cfg == 0x20) raw = raw & ~3; // 10 bit res, 187.5 ms
    else if (cfg == 0x40) raw = raw & ~1; // 11 bit res, 375 ms
    //// default is 12 bit resolution, 750 ms conversion time
  }
  celsius = (float)raw / 16.0;

  display.clearDisplay();
  display.drawBitmap( 0, 16, temperature_bits, temperature_width, temperature_height, 1);
  display.setCursor(17,20);
  display.setTextSize(3);
  display.print(celsius,1);
  display.setTextSize(2);
  display.print((char)247);
  display.setTextSize(3);
  display.print("C");
  display.display();
}

unsigned long i;

void loop() {
  i=millis();
  while(millis()-i<5001) {
    time(millis()-i);
  }
  i=millis();
  while(millis()-i<5001) {
    date();
  }
  i=millis();
  while(millis()-i<5001) {
    temperature();
  }
}
